
/*
 * Realme C21Y RMX3261
 *
 * Board       : ums512_1h10
 * Hardware ID : S19610AA1
 * SoC         : Unisoc T610 / UMS512 (SharkL5Pro)
 * CPU         : 2x Cortex-A75 + 6x Cortex-A55
 * GPU         : Mali-G52 MP2
 * RAM variant : 3GB / 4GB
 * Display     : 720 x 1600
 * Storage     : eMMC 5.1
 *
 * References:
 * - Realme C21Y Android 11 TWRP device tree
 * - Realme C21Y official kernel source
 *
 * Board-specific memory map and peripheral addresses are
 * intentionally not fabricated.
 */

/dts-v1/;

/include/ "ums512.dtsi"

/ {
	model = "Realme C21Y RMX3261";

	compatible = "sprd,ums512";

	aliases {
		/*
		 * Serial controller aliases are inherited from
		 * the UMS512 SoC device tree.
		 */
	};

	chosen {
		bootargs = "console=ttyS1,115200n8";
	};
};

/*
 * The following hardware blocks are inherited from ums512.dtsi.
 *
 * CPU:
 *   2x Cortex-A75
 *   6x Cortex-A55
 *
 * Interrupt controller:
 *   GICv3 (SoC definition)
 *
 * Timer:
 *   ARM architectural timer (SoC definition)
 *
 * PSCI:
 *   SMC method (SoC definition)
 *
 * UART:
 *   ttyS1, 115200n8
 *
 * Not enabled here until the original C21Y DTB is decoded:
 *   - DRAM memory regions
 *   - reserved-memory / modem / TEE / DSP
 *   - eMMC controller and PHY
 *   - display DPU / DSI / panel
 *   - touchscreen
 *   - GPU
 *   - camera
 *   - PMIC and regulators
 *   - USB and charging
 *   - Wi-Fi and Bluetooth
 */
